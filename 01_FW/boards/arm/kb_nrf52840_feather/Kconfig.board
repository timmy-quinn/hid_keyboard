## 01_FW/boards/arm/kb_nrf52840_feather/Kconfig.board
```kconfig
# Adafruit Feather nRF52840 Express board configuration

# Copyright (c) 2020 Tobias Svehagen
# SPDX-License-Identifier: Apache-2.0

config BOARD_KB_NRF52840_FEATHER
	bool "Adafruit Feather nRF52840 Express"
	depends on SOC_NRF52840_QIAA
```

## 01_FW/boards/arm/kb_nrf52840_feather/Kconfig.defconfig
```kconfig
# Adafruit Feather nRF52840 Express board configuration

# Copyright (c) 2020 Tobias Svehagen
# SPDX-License-Identifier: Apache-2.0

if BOARD_KB_NRF52840_FEATHER

config BOARD
	default "kb_nrf52840_feather"

config BT_CTLR
	default BT

endif # BOARD_ADAFRUIT_FEATHER_NRF52840
```
